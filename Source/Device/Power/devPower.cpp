#include "devPower.h"
#include "../devHardware.h"
#include "../ADConverter/devADConverter.h"
//---------------------------------------------------------------------------------------



//---------------------------------------------------------------------------------------







/* //===================================================================================*
* //                                                                                    *
* // Constructor																		*
* //------------------------------------------------------------------------------------*
*///
APower :: APower()
	:
	m_batt			(0),
	m_battMin		(0),
	m_battMax		(0),
	m_carrier		(0),
	m_carrierMin	(0),
	m_carrierMax	(0),
	m_timeLast		(0)
{
	
}
//---------------------------------------------------------------------------------------









/* //===================================================================================*
* //                                                                                    *
* // Инциализация батарей																*
* //------------------------------------------------------------------------------------*
*///
void APower :: initialization()
{
	
}
//---------------------------------------------------------------------------------------







/* //===================================================================================*
* //                                                                                    *
* // системное обновелине мониторинга питания											*
* //------------------------------------------------------------------------------------*
*///
void APower :: update(const ATime &time)
{
	m_timeLast += time.elapsed();
	if (m_timeLast <= 0)
	{
		m_timeLast -= ATime::fromMS(POWER_SLEEP_MS);
		AHardware *hardware = ptrHardware;
	
		/* напряжение батарейки
		 * изменение максимального и минимального значения
		*/
		m_batt  = (hardware->adc.getMillivolt(channelADC0) * 3 + 1) / 2;	
		if (m_batt > m_battMax)
		{
			m_battMax = m_batt;
		}
		if (m_batt < m_battMin || m_battMin == 0)
		{
			m_battMin = m_batt;
		}
		
		
		/* потребление электроэнергии
		*/
		m_carrier = hardware->adc.getADC(channelADC6) - 500;
		if (m_carrier > m_carrierMax)
		{
			m_carrierMax = m_carrier;
		}
		if (m_carrier < m_carrierMin || m_carrierMin == 0)
		{
			m_carrierMin = m_carrier;	
		}			
		
		
	
	}		
}
//---------------------------------------------------------------------------------------






/* //===================================================================================*
* //                                                                                    *
* // возвратим напряжение батарейки в миливольтах										*
* //------------------------------------------------------------------------------------*
*///
int APower :: getBatteryVoltage() const
{
	return m_batt;
}
//---------------------------------------------------------------------------------------





/* //===================================================================================*
* //                                                                                    *
* // Минимальное напряжение батарейки													*
* //------------------------------------------------------------------------------------*
*///
int APower :: getBatteryVoltageMin() const
{
	return m_battMin;
}
//---------------------------------------------------------------------------------------






/* //===================================================================================*
* //                                                                                    *
* // Максимально зафиксированное напряжение батарейки									*
* //------------------------------------------------------------------------------------*
*///
int APower :: getBatteryVoltageMax() const
{
	return m_battMax;
}
//---------------------------------------------------------------------------------------






/* //===================================================================================*
* //                                                                                    *
* // Текущая нагрузка на батарею														*
* //------------------------------------------------------------------------------------*
*///
int APower :: getCarrier() const
{
	return m_carrier;
}
//---------------------------------------------------------------------------------------






/* //===================================================================================*
* //                                                                                    *
* // Минимальная нагрузка на батарею													*
* //------------------------------------------------------------------------------------*
*///
int APower :: getCarrierMin() const
{
	return m_carrierMin;
}
//---------------------------------------------------------------------------------------






/* //===================================================================================*
* //                                                                                    *
* // Максимальная нагрузка на батарею													*
* //------------------------------------------------------------------------------------*
*///
int APower :: getCarrierMax() const
{
	return m_carrierMax;
}
//---------------------------------------------------------------------------------------

