#include "rtBumperSensor.h"
///----------------------------------------------------------------------------





///----------------------------------------------------------------------------
static ABumperSensor bumper;
///----------------------------------------------------------------------------






 ///---------------------------------------------------------------------------
///
/// Constructor
///
///----------------------------------------------------------------------------
ABumperSensor :: ABumperSensor()
{

}
///----------------------------------------------------------------------------




 ///---------------------------------------------------------------------------
///
/// Destructor
///
///----------------------------------------------------------------------------
ABumperSensor :: ~ABumperSensor()
{

}
///----------------------------------------------------------------------------




 ///---------------------------------------------------------------------------
///
/// настройка
///
///----------------------------------------------------------------------------
void ABumperSensor:: begin()
{
	pinMode(Setting::pinBumperA, INPUT);
	pinMode(Setting::pinBumperB, INPUT);
}
///----------------------------------------------------------------------------




 ///---------------------------------------------------------------------------
///
/// левый сенсор
///
///----------------------------------------------------------------------------
bool ABumperSensor:: left() const
{
	return mLeft;
	//return digitalRead(Setting::pinBumperA) == 0;
}
///----------------------------------------------------------------------------






 ///---------------------------------------------------------------------------
///
/// правый сенсор
///
///----------------------------------------------------------------------------
bool ABumperSensor:: right() const
{
	return mRight;
	//return digitalRead(Setting::pinBumperB) == 0;
}
///----------------------------------------------------------------------------





 ///---------------------------------------------------------------------------
///
/// обновление
///
///----------------------------------------------------------------------------
void ABumperSensor :: update()
{
	//left
	mFLeft = mFLeft << 1;
	if (digitalRead(Setting::pinBumperA) == 0)
	{
		mFLeft |= 1;
	}

	//right
	mFRight = mFRight << 1;
	if (digitalRead(Setting::pinBumperB) == 0)
	{
		mFRight |= 1;
	}
	


	const bool l = mFLeft > 0 ? true : false;
	const bool r = mFRight > 0 ? true : false;




	if (mLeft == l && mRight == r)
	{
		return;
	}

	mLeft = l;
	mRight = r;


	if (signal_detect)
	{
		signal_detect();
	}
}
///----------------------------------------------------------------------------





